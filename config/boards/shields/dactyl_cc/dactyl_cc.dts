&i2c1 {
    status = "okay";
    clock-frequency = <I2C_BITRATE_FAST>;
    niceview: niceview@3c {
        compatible = "niceview,ssd1306";
        reg = <0x3c>;
        label = "NICEVIEW";
        height = <32>;
        width = <128>;
        segment-offset = <0>;
        pages = <4>;
        reset-gpios = <&gpio0 10 GPIO_ACTIVE_LOW>;
    };
};

&niceview {
    label = "Nice!View Display";
    niceview,label-template = "%k";
};

