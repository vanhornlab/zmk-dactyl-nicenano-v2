// dactyl_cc_left.overlay

#include "dactyl_cc.dtsi" // Notice that the main dtsi files are included in the overlay.

&kscan0 {
    col-gpios
        = <&gpio0 22 GPIO_ACTIVE_HIGH> // col5 in the schematic
        , <&gpio0 24 GPIO_ACTIVE_HIGH> // col4 in the schematic
        , <&gpio1 0  GPIO_ACTIVE_HIGH> // col3 in the schematic
        , <&gpio0 11 GPIO_ACTIVE_HIGH> // col2 in the schematic
        , <&gpio1 4  GPIO_ACTIVE_HIGH> // col1 in the schematic
        , <&gpio1 6  GPIO_ACTIVE_HIGH> // col0 in the schematic
        ;
};

&spi1 {
    status = "okay";
    cs-gpios = <&gpio1 10 GPIO_ACTIVE_LOW>;
    mosi-pin = <11>;
    sck-pin = <12>;

    nice_view_spi: nice_view_spi@0 {
        compatible = "nice_view";
        reg = <0>;
        spi-max-frequency = <10000000>;
        label = "NICE_VIEW";
    };
};
